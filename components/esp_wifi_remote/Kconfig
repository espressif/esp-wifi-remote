## components/esp_wifi_remote/Kconfig
```kconfig
menu "Wi-Fi Remote"
    config ESP_WIFI_REMOTE_ENABLED
        bool
        default y if !ESP_HOST_WIFI_ENABLED
        default n if ESP_HOST_WIFI_ENABLED

    if ESP_WIFI_REMOTE_ENABLED
        # Resolve version-specific includes via generated fragment located in the build directory.
        config ESP_IDF_VERSION
            string
            default "$ESP_IDF_VERSION"
        if ESP_IDF_VERSION>"5.3"
            orsource "./Kconfig.$IDF_VERSION.in"
        endif
        if ESP_IDF_VERSION<="5.4"
            rsource "./idf_v$ESP_IDF_VERSION/Kconfig.in"
        endif

        rsource "./Kconfig.rpc.in"

        config ESP_WIFI_REMOTE_EAP_ENABLED
            bool "Enable EAP client remote API"
            default y
            depends on WIFI_RMT_ENTERPRISE_SUPPORT
            help
                When enabled, the EAP client remote API will be available.
                This allows remote control of EAP authentication functions.
    endif
    if !ESP_WIFI_REMOTE_ENABLED

        # This helper variables is only used to indicate that Wi-Fi remote if OFF
        # and explains why
        config ESP_WIFI_REMOTE_IS_DISABLED
            bool "Wi-Fi Remote is disabled (Host Wi-Fi is ON)"
            default y
            help
                Wi-Fi Remote is disabled because ESP_HOST_WIFI_ENABLED is ON.
                These options are mutually exclusive.
                Disable ESP_HOST_WIFI_ENABLED to use ESP_WIFI_REMOTE.

        config ESP_WIFI_REMOTE_FORCE_DISABLED
            bool
            default y
            select ESP_WIFI_REMOTE_IS_DISABLED
    endif

endmenu # Wi-Fi Remote
```

## components/esp_wifi_remote/Kconfig.5.3.4.in
```kconfig
orsource "./idf_tag_v5.3.4/Kconfig.in"

if !ESP_WIFI_REMOTE_IDF_SPECIFIC_ADDED
rsource "./idf_v5.3/Kconfig.in"
endif
```

## components/esp_wifi_remote/Kconfig.5.4.1.in
```kconfig
orsource "./idf_tag_v5.4.1/Kconfig.in"

if !ESP_WIFI_REMOTE_IDF_SPECIFIC_ADDED
rsource "./idf_v5.4/Kconfig.in"
endif
```

## components/esp_wifi_remote/Kconfig.5.5.0.in
```kconfig
orsource "./idf_tag_v5.5.0/Kconfig.in"

if !ESP_WIFI_REMOTE_IDF_SPECIFIC_ADDED
rsource "./idf_v5.5/Kconfig.in"
endif
```

## components/esp_wifi_remote/Kconfig.5.5.1.in
```kconfig
orsource "./idf_tag_v5.5.1/Kconfig.in"

if !ESP_WIFI_REMOTE_IDF_SPECIFIC_ADDED
rsource "./idf_v5.5/Kconfig.in"
endif
```

## components/esp_wifi_remote/Kconfig.6.0.0.in
```kconfig
orsource "./idf_tag_v6.0/Kconfig.in"

if !ESP_WIFI_REMOTE_IDF_SPECIFIC_ADDED
rsource "./idf_v6.0/Kconfig.in"
endif
```

## components/esp_wifi_remote/Kconfig.idf_v5.3.in
```kconfig
config ESP_WIFI_REMOTE_IDF_SPECIFIC_ADDED
    bool
    default y

rsource "./idf_v5.3/Kconfig.slave_select.in"
rsource "./idf_v5.3/Kconfig.soc_wifi_caps.in"

menu "Wi-Fi configuration"
    rsource "./idf_v5.3/Kconfig.wifi.in"
endmenu
```

## components/esp_wifi_remote/Kconfig.idf_v5.4.in
```kconfig
config ESP_WIFI_REMOTE_IDF_SPECIFIC_ADDED
    bool
    default y

rsource "./idf_v5.4/Kconfig.slave_select.in"
rsource "./idf_v5.4/Kconfig.soc_wifi_caps.in"

menu "Wi-Fi configuration"
    rsource "./idf_v5.4/Kconfig.wifi.in"
endmenu
```

## components/esp_wifi_remote/Kconfig.idf_v5.5.in
```kconfig
config ESP_WIFI_REMOTE_IDF_SPECIFIC_ADDED
    bool
    default y

rsource "./idf_v5.5/Kconfig.slave_select.in"
rsource "./idf_v5.5/Kconfig.soc_wifi_caps.in"

menu "Wi-Fi configuration"
    rsource "./idf_v5.5/Kconfig.wifi.in"
endmenu
```

## components/esp_wifi_remote/Kconfig.idf_v6.1.in
```kconfig
config ESP_WIFI_REMOTE_IDF_SPECIFIC_ADDED
    bool
    default y

rsource "./idf_v6.1/Kconfig.slave_select.in"
rsource "./idf_v6.1/Kconfig.soc_wifi_caps.in"

menu "Wi-Fi configuration"
    rsource "./idf_v6.1/Kconfig.wifi.in"
endmenu
```

## components/esp_wifi_remote/examples/two_stations/main/Kconfig.projbuild
```kconfig
menu "Example Configuration"

    config ESP_WIFI_LOCAL_ENABLE
        bool "Enable Local WiFi"
        default y
        help
            Enable local WiFi station connection.

    config ESP_WIFI_REMOTE_ENABLE
        bool "Enable Remote WiFi"
        default y
        help
            Enable remote WiFi station connection.

    config ESP_WIFI_LOCAL_SSID
        string "Local WiFi SSID"
        default "myssid"
        depends on ESP_WIFI_LOCAL_ENABLE
        help
            SSID (network name) for the example to connect to.

    config ESP_WIFI_LOCAL_PASSWORD
        string "Local WiFi Password"
        default "mypassword"
        depends on ESP_WIFI_LOCAL_ENABLE
        help
            WiFi password (WPA or WPA2) for the example to use.

    choice ESP_WIFI_REMOTE_MODE
        bool "Remote WiFi as Station or AP"
        depends on ESP_WIFI_REMOTE_ENABLE
        default ESP_WIFI_REMOTE_STA
        help
            Sets either station or softAP

        config ESP_WIFI_REMOTE_STA
            bool "WiFi Remote Station"

        config ESP_WIFI_REMOTE_AP
            bool "WiFi Remote AP"

    endchoice

    config ESP_WIFI_REMOTE_SSID
        string "Remote WiFi SSID"
        default "myssid"
        depends on ESP_WIFI_REMOTE_ENABLE
        help
            SSID (network name) for the example to connect to.

    config ESP_WIFI_REMOTE_PASSWORD
        string "Remote WiFi Password"
        default "mypassword"
        depends on ESP_WIFI_REMOTE_ENABLE
        help
            WiFi password (WPA or WPA2) for the example to use.

    config ESP_WIFI_REMOTE_MAX_RETRIES
        int "Maximum retry"
        default 5
        depends on ESP_WIFI_REMOTE_ENABLE
        help
            Set the Maximum retry to avoid station reconnecting to the AP unlimited when the AP is really inexistent.

    config ESP_WIFI_REMOTE_MAX_STATIONS
        int "Maximum number of stations"
        default 5
        depends on ESP_WIFI_REMOTE_ENABLE
        help
            Set the Maximum number of stations connected to the AP.

endmenu
```

## components/esp_wifi_remote/idf_tag_v5.4.2/Kconfig.in
```kconfig
config ESP_WIFI_REMOTE_IDF_SPECIFIC_ADDED
    bool
    default y

rsource "./Kconfig.slave_select.in"
rsource "./Kconfig.soc_wifi_caps.in"

menu "Wi-Fi configuration"
    rsource "./Kconfig.wifi.in"
endmenu
```

## components/esp_wifi_remote/idf_v5.3/Kconfig.in
```kconfig
rsource "./Kconfig.slave_select.in"
rsource "./Kconfig.soc_wifi_caps.in"

menu "Wi-Fi configuration"
    rsource "./Kconfig.wifi.in"
endmenu
```

## components/wifi_remote_over_at/Kconfig
```kconfig
menu "Wi-Fi Remote over AT"

    menu "UART Configuration"

        choice WIFI_RMT_AT_FLOW_CONTROL
            bool "Set preferred modem control flow"
            default WIFI_RMT_AT_FLOW_CONTROL_NONE
            help
                Set the preferred control flow

            config WIFI_RMT_AT_FLOW_CONTROL_NONE
                bool "No control flow"
            config WIFI_RMT_AT_FLOW_CONTROL_SW
                bool "SW control flow"
            config WIFI_RMT_AT_FLOW_CONTROL_HW
                bool "HW control flow"
        endchoice

        config WIFI_RMT_AT_UART_TX_PIN
            int "TXD Pin Number"
            default 25
            range 0 56
            help
                Pin number of UART TX.

        config WIFI_RMT_AT_UART_RX_PIN
            int "RXD Pin Number"
            default 26
            range 0 56
            help
                Pin number of UART RX.

        config WIFI_RMT_AT_UART_RTS_PIN
            int "RTS Pin Number"
            default 27
            range 0 56
            help
                Pin number of UART RTS.

        config WIFI_RMT_AT_UART_CTS_PIN
            int "CTS Pin Number"
            default 23
            range 0 56
            help
                Pin number of UART CTS.

        config WIFI_RMT_AT_UART_EVENT_TASK_STACK_SIZE
            int "UART Event Task Stack Size"
            range 2000 6000
            default 4096
            help
                Stack size of UART event task.

        config WIFI_RMT_AT_UART_EVENT_TASK_PRIORITY
            int "UART Event Task Priority"
            range 3 22
            default 5
            help
                Priority of UART event task.

        config WIFI_RMT_AT_UART_EVENT_QUEUE_SIZE
            int "UART Event Queue Size"
            range 10 40
            default 30
            help
                Length of UART event queue.

        config WIFI_RMT_AT_UART_PATTERN_QUEUE_SIZE
            int "UART Pattern Queue Size"
            range 10 40
            default 20
            help
                Length of UART pattern queue.

        config WIFI_RMT_AT_UART_TX_BUFFER_SIZE
            int "UART TX Buffer Size"
            range 256 2048
            default 512
            help
                Buffer size of UART TX buffer.

        config WIFI_RMT_AT_UART_RX_BUFFER_SIZE
            int "UART RX Buffer Size"
            range 256 2048
            default 1024
            help
                Buffer size of UART RX buffer.
    endmenu


endmenu # Wi-Fi Remote over EPPP
```

## components/wifi_remote_over_eppp/Kconfig
```kconfig
menu "Wi-Fi Remote over EPPP"

if ESP_WIFI_REMOTE_LIBRARY_EPPP

    config WIFI_RMT_OVER_EPPP_UNSECURE
        bool "Enable unsecure mode"
        default n
        help
            Enable unsecure mode.
            This will disable the TLS encryption and authentication.
            This is useful for testing purposes.

    if EPPP_LINK_DEVICE_UART
        config WIFI_RMT_OVER_EPPP_UART_PORT
            int "UART port number"
            default 1
            range 0 3
            help
                UART Port number.

        config WIFI_RMT_OVER_EPPP_UART_TX_PIN
            int "TXD Pin Number"
            default 10
            range 0 54
            help
                Pin number of UART TX.

        config WIFI_RMT_OVER_EPPP_UART_RX_PIN
            int "RXD Pin Number"
            default 11
            range 0 54
            help
                Pin number of UART RX.
    endif

    if EPPP_LINK_DEVICE_SPI
        config WIFI_RMT_OVER_EPPP_SPI_HOST
            int "SPI host number"
            default 1
            range 0 3
            help
                SPI host number.

        config WIFI_RMT_OVER_EPPP_SPI_MOSI_PIN
            int "MOSI Pin Number"
            default 23
            range 0 54
            help
                Pin number of SPI MOSI.

        config WIFI_RMT_OVER_EPPP_SPI_MISO_PIN
            int "MISO Pin Number"
            default 19
            range 0 54
            help
                Pin number of SPI MISO.

        config WIFI_RMT_OVER_EPPP_SPI_SCLK_PIN
            int "SCLK Pin Number"
            default 18
            range 0 54
            help
                Pin number of SPI SCLK.

        config WIFI_RMT_OVER_EPPP_SPI_CS_PIN
            int "CS Pin Number"
            default 5
            range 0 54
            help
                Pin number of SPI CS.

        config WIFI_RMT_OVER_EPPP_SPI_INTR_PIN
            int "Interrupt Pin Number"
            default 17
            range 0 54
            help
                Pin number of SPI interrupt.

        config WIFI_RMT_OVER_EPPP_SPI_FREQ
            int "SPI frequency"
            default 4000000
            range 1000000 20000000
            help
                SPI frequency in Hz.
    endif

    if EPPP_LINK_DEVICE_SDIO
        config WIFI_RMT_OVER_EPPP_SDIO_WIDTH
            int "SDIO bus width"
            default 4
            range 1 4
            help
                SDIO bus width (1, 2, or 4 bits).

        config WIFI_RMT_OVER_EPPP_SDIO_CLK_PIN
            int "CLK Pin Number"
            default 18
            range 0 54
            help
                Pin number of SDIO CLK.

        config WIFI_RMT_OVER_EPPP_SDIO_CMD_PIN
            int "CMD Pin Number"
            default 19
            range 0 54
            help
                Pin number of SDIO CMD.

        config WIFI_RMT_OVER_EPPP_SDIO_D0_PIN
            int "D0 Pin Number"
            default 14
            range 0 54
            help
                Pin number of SDIO D0.

        config WIFI_RMT_OVER_EPPP_SDIO_D1_PIN
            int "D1 Pin Number"
            default 15
            range 0 54
            help
                Pin number of SDIO D1.

        config WIFI_RMT_OVER_EPPP_SDIO_D2_PIN
            int "D2 Pin Number"
            default 16
            range 0 54
            help
                Pin number of SDIO D2.

        config WIFI_RMT_OVER_EPPP_SDIO_D3_PIN
            int "D3 Pin Number"
            default 17
            range 0 54
            help
                Pin number of SDIO D3.
    endif

    config WIFI_RMT_OVER_EPPP_HOST_SIDE_NETIF
        bool "Enable host side netif"
        default n
        select EPPP_LINK_CHANNELS_SUPPORT
        help
            Enable host side netifwork interface (Remote WiFi station) that uses EPPP channels
            for sending and receiving 802.3 frames over EPPP.
            Enable this if host behind NAT would cause issues.
            Downside is that the slave side does not have a direct access to the internet.

    config WIFI_RMT_OVER_EPPP_NETIF_PRIORITY
        int "Routing priority of eppp netif"
        default 100
        default 50 if WIFI_RMT_OVER_EPPP_HOST_SIDE_NETIF
        range 0 256
        help
            Set the priority of the wifi-remote netif.
            The bigger the number the higher the priority.
            The interface which is up and with the highest priority will act as a default GW.

    config WIFI_RMT_OVER_EPPP_NETIF_DESCRIPTION
        string "eppp network interface description"
        default "example_netif_sta"
        help
            Textual description of the wifi remote network interface.
            By default it is set to "example_netif_sta" to be used in IDF protocol example
            as default wifi station substitution.

    config WIFI_RMT_OVER_EPPP_SERVER_CA
        string "Servers CA certificate"
        default "--- Please copy content of the CA certificate ---"

    config WIFI_RMT_OVER_EPPP_CLIENT_CRT
        string "Client certificate"
        default "--- Please copy content of the Client certificate ---"

    config WIFI_RMT_OVER_EPPP_CLIENT_KEY
        string "Client key"
        default "--- Please copy content of the Client key ---"

    config WIFI_RMT_OVER_EPPP_CLIENT_CA
        string "Clients CA certificate"
        default "--- Please copy content of the CA certificate ---"

    config WIFI_RMT_OVER_EPPP_SERVER_CRT
        string "Server certificate"
        default "--- Please copy content of the Client certificate ---"

    config WIFI_RMT_OVER_EPPP_SERVER_KEY
        string "Server key"
        default "--- Please copy content of the Client key ---"

    config WIFI_RMT_OVER_EPPP_SERVER_CN
        string "Server common name"
        default "espressif.local"
        help
            Common name of the EPPP server.
            This is checked when establishing a TLS connection
            between the EPPP client and server. This CN should
            match the CN in your server certificate.

endif # ESP_WIFI_REMOTE_LIBRARY_EPPP

endmenu # Wi-Fi Remote over EPPP
```
